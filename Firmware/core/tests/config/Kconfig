## Firmware/core/tests/config/Kconfig
```kconfig
mainmenu "Spaghetti Config tests"

rsource "../../Kconfig.resources"

config SPAGHETTI_MAX_MODULES
	int
	default 8

config SPAGHETTI_CONFIG_LOG_LEVEL
	int
	default 0

config SPAGHETTI_DISCOVERY_MAX_RESULTS
	int
	default 8

config SPAGHETTI_DISCOVERY_LOG_LEVEL
	int
	default 0

config SPAGHETTI_MODULE_MANAGER_LOG_LEVEL
	int
	default 0

config SPAGHETTI_RUNTIME_STOP_TIMEOUT_MS
	int
	default 1000

config SPAGHETTI_MQTT_STOP_TIMEOUT_MS
	int
	default 2000

source "Kconfig.zephyr"
```

## Firmware/core/tests/config_codec/Kconfig
```kconfig
mainmenu "Spaghetti Config codec tests"

rsource "../../Kconfig.resources"

source "Kconfig.zephyr"
```

## Firmware/core/tests/connectivity/Kconfig
```kconfig
mainmenu "Spaghetti Connectivity Manager tests"

rsource "../../subsys/connectivity/Kconfig"

source "Kconfig.zephyr"
```

## Firmware/core/tests/core/Kconfig
```kconfig
mainmenu "Spaghetti Core tests"

config SPAGHETTI_CORE_LOG_LEVEL
	int
	default 0

source "Kconfig.zephyr"
```

## Firmware/core/tests/core/testcase.yaml
```yaml
tests:
  spaghetti.core:
    platform_allow:
      - native_sim/native/64
    tags:
      - spaghetti
      - core
      - engine
```

## Firmware/core/tests/driver_registry/Kconfig
```kconfig
mainmenu "Spaghetti Driver Registry tests"

config SPAGHETTI_DRIVER_REGISTRY_LOG_LEVEL
	int
	default 0

source "Kconfig.zephyr"
```

## Firmware/core/tests/energy/Kconfig
```kconfig
mainmenu "Spaghetti Energy policy tests"

rsource "../../subsys/connectivity/Kconfig"
rsource "../../subsys/power/Kconfig"

source "Kconfig.zephyr"
```

## Firmware/core/tests/module_manager/Kconfig
```kconfig
mainmenu "Spaghetti Module Manager tests"

rsource "../../Kconfig.resources"

config SPAGHETTI_MODULE_MANAGER_LOG_LEVEL
	int
	default 0

source "Kconfig.zephyr"
```

## Firmware/core/tests/ota/Kconfig
```kconfig
mainmenu "Spaghetti OTA tests"

config SPAGHETTI_OTA_LOG_LEVEL
	int
	default 0

config SPAGHETTI_OTA_PORT
	int
	default 1337

config SPAGHETTI_OTA_MAX_WINDOW_MS
	int
	default 100

config SPAGHETTI_OTA_WORK_STACK_SIZE
	int
	default 1024

config SPAGHETTI_OTA_WORK_PRIORITY
	int
	default 5

config SPAGHETTI_MAINTENANCE_REBOOT_DELAY_MS
	int
	default 10

source "Kconfig.zephyr"
```

## Firmware/core/tests/relay/Kconfig
```kconfig
mainmenu "Spaghetti Relay tests"

rsource "../../Kconfig.resources"

config SPAGHETTI_RELAY_LOG_LEVEL
	int
	default 0

config SPAGHETTI_RELAY_MAX_INSTANCES
	int
	default 2

source "Kconfig.zephyr"
```

## Firmware/core/tests/remote_console/Kconfig
```kconfig
mainmenu "Spaghetti Remote Console tests"

config SPAGHETTI_REMOTE_CONSOLE_LOG_LEVEL
	int
	default 0

config SPAGHETTI_REMOTE_CONSOLE_PORT
	int
	default 1338

source "Kconfig.zephyr"
```

## Firmware/core/tests/update/Kconfig
```kconfig
mainmenu "Spaghetti Update tests"

config SPAGHETTI_UPDATE_LOG_LEVEL
	int
	default 0

config SPAGHETTI_UPDATE_WORK_STACK_SIZE
	int
	default 1024

config SPAGHETTI_UPDATE_WORK_PRIORITY
	int
	default 5

config SPAGHETTI_UPDATE_TEST_TRIAL
	bool "Start the fake backend in trial boot"
	default n

source "Kconfig.zephyr"
```

## Firmware/core/tests/wifi_profiles/testcase.yaml
```yaml
tests:
  spaghetti.wifi_profiles:
    platform_allow:
      - native_sim/native/64
    tags:
      - spaghetti
      - wifi
      - storage
```
